## examples/SL2610_PEK/configs/cm52_dma_sample_app_pek_defconfig
```kconfig
CONFIG_PROJECT="sl2610"
CONFIG_BUILD_TYPE="cm52_fw"
CONFIG_BUILD_MODE="release"
CONFIG_COMPILER="gcc"
CONFIG_TOOLCHAIN="GCC.13.2.1"
CONFIG_BOARD="sl2610_pek"
CONFIG_MODULE_CACHE_ENABLED=y
CONFIG_MODULE_DMA_ENABLED=y
CONFIG_MODULE_DMA_250_ENABLED=y
CONFIG_MODULE_MPU_ENABLED=y
CONFIG_MODULE_PINMUX_ENABLED=y
CONFIG_MODULE_UART_ENABLED=y
CONFIG_MODULE_UART_HIGH_BAUD_RATE=115200
CONFIG_MODULE_UART_LOW_BAUD_RATE=115200
CONFIG_INFRA_DMEM_ENABLED=y
CONFIG_INFRA_LOGGER_ENABLED=y
CONFIG_LOGGER_IF_UART_0=y
CONFIG_RTOS_FreeRTOS_HEAP_5=y
CONFIG_SECLIB_ENABLED=y
CONFIG_DRIVER_SAMPLE_APP_ENABLED=y
CONFIG_DMA_SAMPLE_APP_ENABLED=y
```

## examples/SL2610_PEK/configs/cm52_emmc_pek_defconfig
```kconfig
CONFIG_PROJECT="sl2610"
CONFIG_BUILD_TYPE="cm52_fw"
CONFIG_BUILD_MODE="release"
CONFIG_COMPILER="gcc"
CONFIG_TOOLCHAIN="GCC.13.2.1"
CONFIG_BOARD="sl2610_pek"
CONFIG_SM_DDR_HEAP_SIZE=0x8000000
CONFIG_LOGGER_BAUD_RATE=57600
CONFIG_MODULE_EMMC_ENABLED=y
CONFIG_MODULE_UART_ENABLED=y
CONFIG_MODULE_UART_HIGH_BAUD_RATE=115200
CONFIG_INFRA_DMEM_ENABLED=y
CONFIG_INFRA_LOGGER_ENABLED=y
CONFIG_LOGGER_IF_UART_0=y
CONFIG_SERVICE_SYNA_ENABLED=y
CONFIG_MODULE_SYS_EVENT_ENABLED=y
CONFIG_CMSIS_FREERTOS_ENABLED=y
CONFIG_SECLIB_ENABLED=y
CONFIG_FREERTOS_OS_ENABLED=y
CONFIG_RTOS_FreeRTOS_HEAP_5=y
CONFIG_DRIVER_SAMPLE_APP_ENABLED=y
CONFIG_EMMC_SAMPLE_APP=y
```

## examples/SL2610_PEK/configs/cm52_i2c_scan_app_pek_defconfig
```kconfig
CONFIG_PROJECT="sl2610"
CONFIG_BUILD_TYPE="cm52_fw"
CONFIG_BUILD_MODE="release"
CONFIG_COMPILER="gcc"
CONFIG_TOOLCHAIN="GCC.13.2.1"
CONFIG_BOARD="sl2610_pek"
CONFIG_SM_DDR_HEAP_SIZE=0x8000000
CONFIG_LOGGER_BAUD_RATE=115200
CONFIG_MODULE_I2C_ENABLED=y
CONFIG_MODULE_CACHE_ENABLED=y
CONFIG_MODULE_IO_EXPANDER_ENABLED=y
CONFIG_MODULE_FXL6408_ENABLED=y
CONFIG_I2C_DEFAULT_SLAVE_ADDR=0x42
CONFIG_MODULE_UART_ENABLED=y
CONFIG_MODULE_UART_HIGH_BAUD_RATE=115200
CONFIG_MODULE_TIMER_ENABLED=y
CONFIG_MODULE_XSPI_ENABLED=y
CONFIG_MODULE_XSPI_FLASH_ENABLED=y
CONFIG_INFRA_DMEM_ENABLED=y
CONFIG_INFRA_LOGGER_ENABLED=y
CONFIG_LOGGER_TIMEOUT_MS=10
CONFIG_LOGGER_IF_UART_0=y
CONFIG_MODULE_SYS_EVENT_ENABLED=y
CONFIG_CMSIS_FREERTOS_ENABLED=y
CONFIG_DDR_TYPE_DDR4=y
CONFIG_DDR4_3200_2X8=y
CONFIG_DDR_TYPE=1
CONFIG_SECLIB_ENABLED=y
CONFIG_FREERTOS_OS_ENABLED=y
CONFIG_RTOS_FreeRTOS_HEAP_5=y
CONFIG_DRIVER_SAMPLE_APP_ENABLED=y
CONFIG_I2C_SCAN_SAMPLE_APP=y
```

## examples/SL2610_PEK/configs/cm52_spwm_sample_app_pek_defconfig
```kconfig
CONFIG_PROJECT="sl2610"
CONFIG_BUILD_TYPE="cm52_fw"
CONFIG_BUILD_MODE="release"
CONFIG_COMPILER="gcc"
CONFIG_TOOLCHAIN="GCC.13.2.1"
CONFIG_BOARD="sl2610_pek"
CONFIG_SM_DDR_HEAP_SIZE=0x8000000
CONFIG_LOGGER_BAUD_RATE=115200
CONFIG_MODULE_EMMC_ENABLED=y
CONFIG_MODULE_CACHE_ENABLED=y
CONFIG_MODULE_TIMER_ENABLED=y
CONFIG_MODULE_UART_ENABLED=y
CONFIG_MODULE_UART_HIGH_BAUD_RATE=115200
CONFIG_MODULE_SPWM_ENABLED=y
CONFIG_INFRA_DMEM_ENABLED=y
CONFIG_SERVICE_IMAGE_PARSER_ENABLED=y
CONFIG_INFRA_LOGGER_ENABLED=y
CONFIG_LOGGER_IF_UART_0=y
CONFIG_SYNA_SERVICE_ENABLED=y
CONFIG_SERVICE_SYNA_ENABLED=y
CONFIG_CMSIS_FREERTOS_ENABLED=y
CONFIG_CMSIS_UNITY_ENABLED=y
CONFIG_SECLIB_ENABLED=y
CONFIG_MODULE_XSPI_FLASH_ENABLED=y
CONFIG_MODULE_IS25WX256_ENABLED=y
CONFIG_FREERTOS_OS_ENABLED=y
CONFIG_RTOS_FreeRTOS_HEAP_5=y
CONFIG_DRIVER_SAMPLE_APP_ENABLED=y
CONFIG_SPWM_SAMPLE_APP_ENABLED=y
```

## examples/SL2610_PEK/configs/sl2610_system_manager_lpddr4_pek_defconfig
```kconfig
CONFIG_PROJECT="sl2610"
CONFIG_BUILD_TYPE="cm52_fw"
CONFIG_BUILD_MODE="release"
CONFIG_COMPILER="gcc"
CONFIG_TOOLCHAIN="GCC.13.2.1"
CONFIG_BOARD="sl2610_pek"
CONFIG_SM_DDR_HEAP_SIZE=0x8000000
CONFIG_LOGGER_BAUD_RATE=115200
CONFIG_MODULE_EMMC_ENABLED=y
CONFIG_MODULE_CACHE_ENABLED=y
CONFIG_SET_EMMC_MODE=y
CONFIG_EMMC_MODE_HS200_OPT=y
CONFIG_MODULE_GPIO_ENABLED=y
CONFIG_MODULE_I2C_ENABLED=y
CONFIG_MODULE_IO_EXPANDER_ENABLED=y
CONFIG_MODULE_FXL6408_ENABLED=y
CONFIG_I2C_DEFAULT_SLAVE_ADDR=0x42
CONFIG_MODULE_IPC_V2_ENABLED=y
CONFIG_MODULE_TIMER_ENABLED=y
CONFIG_MODULE_UART_ENABLED=y
CONFIG_MODULE_UART_0_ENABLED=y
CONFIG_MODULE_UART_3_ENABLED=y
CONFIG_MODULE_UART_HIGH_BAUD_RATE=115200
CONFIG_MODULE_XSPI_ENABLED=y
CONFIG_MODULE_XSPI_FLASH_ENABLED=y
CONFIG_INFRA_DMEM_ENABLED=y
CONFIG_INFRA_IMAGE_PARSER_ENABLED=y
CONFIG_INFRA_LOGGER_ENABLED=y
CONFIG_MODULE_LOGGER_TIMEOUT_MS=10
CONFIG_LOG_LVL_LOWEST_AVAILABLE=5
CONFIG_LOGGER_IF_UART_0=y
CONFIG_SYNA_SERVICE_ENABLED=y
CONFIG_MODULE_SYS_EVENT_ENABLED=y
CONFIG_CMSIS_FREERTOS=y
CONFIG_CMSIS_UNITY=y
CONFIG_DDR_LOAD_SUPPORTED=y
CONFIG_DHL_DDR_ENABLED=y
CONFIG_DDR_TYPE=2
CONFIG_DDR_TYPE_LPDDR4=y
CONFIG_DDR4_3200_2X8=y
CONFIG_DDR_RATE=3200
CONFIG_SECLIB_SUPPORTED=y
CONFIG_MODULE_PMIC_ENABLED=y
CONFIG_MODULE_FLASH_ENABLED=y
CONFIG_SERVICE_SYNA_ENABLED=y
CONFIG_MODULE_SYS_EVENT_ENABLED=y
CONFIG_MODULE_SYS_MNG_ENABLED=y
CONFIG_CMSIS_FREERTOS_ENABLED=y
CONFIG_SECLIB_ENABLED=y
CONFIG_MODULE_IS25WX256_ENABLED=y
CONFIG_IO_EXPANDER_SLV_ADDR=0x43
CONFIG_FREERTOS_OS_ENABLED=y
CONFIG_RTOS_FreeRTOS_HEAP_5=y
CONFIG_MODULE_SYSTEM_MANAGER_ENABLED=y
```

## examples/SL2610_PEK/driver_sample_app/emmc_sample_app/kconfig
```kconfig
config EMMC_SAMPLE_APP
    bool "EMMC_SAMPLE_APP"
    help
        This option selects EMMC_SAMPLE_APP
```

## examples/SL2610_PEK/driver_sample_app/i2c_exp_app/kconfig
```kconfig
config I2C_EXP_APP
    bool "I2C_EXP_APP"
    help
        This option selects I2C_EXP_APP
```

## examples/SL2610_PEK/driver_sample_app/i2c_sample_app/kconfig
```kconfig
config I2C_SAMPLE_APP
    bool "I2C_SAMPLE_APP"
    help
        This option selects I2C_SAMPLE_APP
```

## examples/SL2610_PEK/driver_sample_app/i2c_scan_sample_app/kconfig
```kconfig
config I2C_SCAN_SAMPLE_APP
    bool "I2C BUS SCAN APP"
    help
      Enable I2C Bus Scanner sample application.
      This application scans the I2C bus to detect connected devices
      across all valid 7-bit addresses (0x08-0x77).
```

## examples/SL2610_PEK/driver_sample_app/kconfig
```kconfig
config DRIVER_SAMPLE_APP_ENABLED
    bool "DRIVER_SAMPLE_APP_ENABLED"
    help
        This option selects driver sample application.

if DRIVER_SAMPLE_APP_ENABLED

choice
    prompt "Examples Drivers"
    optional
    help
        Select the driver example

        Available driver sample apps
            1. i2c sample app
            2. i2c scan sample app
            3. emmc sample app
            4. dma sample app

rsource "./*/kconfig"

endchoice

endif
```

## examples/SL2610_PEK/system_manager/kconfig
```kconfig
config MODULE_SYSTEM_MANAGER_ENABLED
    bool "System manager"
    help
        This config enables the system manager module
```

## examples/SL2610_RDK/configs/cm52_i2c_exp_app_rdk_defconfig
```kconfig
CONFIG_PROJECT="sl2610"
CONFIG_BUILD_TYPE="cm52_fw"
CONFIG_BUILD_MODE="release"
CONFIG_COMPILER="gcc"
CONFIG_BOARD="sl2610_rdk"
CONFIG_SM_DDR_HEAP_SIZE=0x8000000
CONFIG_LOGGER_BAUD_RATE=57600
CONFIG_MODULE_EMMC_ENABLED=y
CONFIG_SET_EMMC_MODE=y
CONFIG_MODULE_I2C_ENABLED=y
CONFIG_MODULE_IO_EXPANDER_ENABLED=y
CONFIG_I2C_DEFAULT_SLAVE_ADDR=0x42
CONFIG_MODULE_UART_ENABLED=y
CONFIG_MODULE_UART_HIGH_BAUD_RATE=115200
CONFIG_INFRA_DMEM_ENABLED=y
CONFIG_INFRA_LOGGER_ENABLED=y
CONFIG_LOGGER_TIMEOUT_MS=10
CONFIG_LOGGER_IF_UART_0=y
CONFIG_MODULE_SYS_EVENT_ENABLED=y
CONFIG_CMSIS_FREERTOS_ENABLED=y
CONFIG_CMSIS_UNITY_ENABLED=y
CONFIG_DDR_TYPE_DDR4=y
CONFIG_DDR4_3200_2X8=y
CONFIG_DDR_TYPE=1
CONFIG_MODULE_TCA6416A_ENABLED=y
CONFIG_MODULE_FXL6408_ENABLED=y
CONFIG_SECLIB_ENABLED=y
CONFIG_FREERTOS_OS_ENABLED=y
CONFIG_RTOS_FreeRTOS_HEAP_5=y
CONFIG_DRIVER_SAMPLE_APP_ENABLED=y
CONFIG_I2C_EXP_APP=y
```

## examples/SL2610_RDK/driver_sample_app/dma_sample_app/kconfig
```kconfig
config DMA_SAMPLE_APP_ENABLED
    bool "DMA_SAMPLE_APP"
    help
        This option selects DMA_SAMPLE_APP
```

## examples/SL2610_RDK/driver_sample_app/kconfig
```kconfig
config DRIVER_SAMPLE_APP_ENABLED
    bool "DRIVER_SAMPLE_APP_ENABLED"
    help
        This option selects driver sample application.

if DRIVER_SAMPLE_APP_ENABLED

choice
    prompt "Examples Drivers"
    optional
    help
        Select the driver example

        Available driver sample apps
            1. dma sample app

rsource "./*/kconfig"

endchoice

endif
```

## examples/SL2610_RDK/driver_sample_app/spwm_sample_app/kconfig
```kconfig
config SPWM_SAMPLE_APP_ENABLED
    bool "SPWM_SAMPLE_APP_ENABLED"
    depends on MODULE_SPWM_ENABLED
    help
        This option selects SPWM_SAMPLE_APP
```

## examples/SL2610_RDK/driver_sample_app/xspi_sample_app/kconfig
```kconfig
config XSPI_SAMPLE_APP
    bool "XSPI_SAMPLE_APP"
    help
        This option selects XSPI_SAMPLE_APP
```

## examples/SL2610_RDK/kconfig
```kconfig
choice
    prompt "Examples application"
    optional
    help
        Select the example application

        Available usecases
            1. SAMPLE_DEMO_APP
            2. SYSTEM_MANAGER

rsource "./*/kconfig"

endchoice

config UC_AUTO_RUN
    bool "UC_AUTO_RUN"
    default n
    help
        This config automatically create and start the usecase

config INCLUDE_EXAMPLES_DIR
    bool
```

## examples/SR110_RDK/drivers_examples/wifi_sample_app/kconfig
```kconfig
config WIFI_SAMPLE_APP 
    bool "WIFI_SAMPLE_APP"
    help
        This option selects Wifi Sample App. 
```

## srsdk/examples/SR110_RDK/inference_examples/kconfig
```kconfig
config NPU_SAMPLE_APP_ENABLED
    bool "NPU_SAMPLE_APP_ENABLED"
    select MODULE_NPU_ENABLED
    help
        This option selects Inference sample application.

if NPU_SAMPLE_APP_ENABLED

choice
    prompt "Inference sample Application"
    default INFERENCE_BASIC_SAMPLE_APP
    help
        Select the example application

        Available usecases
            1. INFERENCE_BASIC_SAMPLE_APP
            2. INFERENCE_BASIC_FLASH_SAMPLE_APP
            3. INFERENCE_MULTI_MODEL_SAMPLE_APP

    config INFERENCE_BASIC_SAMPLE_APP
        bool "INFERENCE_BASIC_SAMPLE_APP"
        help
            This config enables the Inference Basic sample application

    config INFERENCE_BASIC_FLASH_SAMPLE_APP
        bool "INFERENCE_BASIC_FLASH_SAMPLE_APP"
        help
            This config enables the Inference Basic Flash sample application

    config INFERENCE_MULTI_MODEL_SAMPLE_APP
        bool "INFERENCE_MULTI_MODEL_SAMPLE_APP"
        help
            This config enables the Multi Model Inference sample application

endchoice
endif
```
